ENTRY(KERNEL_ENTRY)

SECTIONS
{
    . = 1M;

    _kernel_start = .;

    .text : ALIGN(4K)
    {
        *(.text*)
    }

    .rodata : ALIGN(4K)
    {
        *(.rodata*)
    }

    .data : ALIGN(4K)
    {
        *(.data*)
    }

    .bss : ALIGN(4K)
    {
        *(COMMON)
        *(.bss*)
    }

    _kernel_end = .;
}
